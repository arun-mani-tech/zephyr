&spi2 {
   can0: mcp2515@1 {
                compatible = "microchip,mcp2515";
                spi-max-frequency = <1000000>;
                int-gpios = <&gpiob 2 GPIO_ACTIVE_LOW>;
                status = "okay";
                label = "CAN_0";
                reg = <0x1>;
                osc-freq = <25000000>;
                bus-speed = <125000>;
                sjw = <1>;
                prop-seg = <8>;
                phase-seg1 = <8>;
                phase-seg2 = <3>;
                #address-cells = <1>;
                #size-cells = <0>;
        };
};
